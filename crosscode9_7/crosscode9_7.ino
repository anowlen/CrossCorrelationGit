//set baud rate for 115200

#define F(string_literal) (reinterpret_cast<const __FlashStringHelper *>(PSTR(string_literal)))

void setup() {
    Serial.begin(115200);
    Serial.println("testing");
    

//10-20 seconds of EVD Flow
float x[] = {0.003683,
0.013102,
0.033211,
0.071657,
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2.078193,
2.07807
};

float y [] = {
  0.003273,
0.011732,
0.029687,
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1.81945,
1.819375
};

pinMode(A0,INPUT);
pinMode(A1,INPUT);
    
    
    int n = sizeof(x) / sizeof(x[0]); 

    float mx = 0, my = 0, sx = 0, sy = 0, sxy, r;
    
    // Calculate mean
    for (int i = 0; i < n; i++) {
        mx += x[i];
        my += y[i];
    }
    mx /= n;
    my /= n;


    Serial.println("test");
    // calculate denominator
    for (int i = 0; i < n; i++) {
        sx += (x[i] - mx) * (x[i] - mx);
        sy += (y[i] - my) * (y[i] - my);
    }
    double denom = sqrt(sx * sy);

    int maxShift2 = n / 2;  // Maximum shift range ->have to divide by 2
    //int maxShift2 = 100; //this makes it match the matlab
    const float Ts = 0.01; //sample rate
    Serial.println("delay,correlation");  //Serial Plotter

    float highr = -1.0;
    float highshift = 0;
    // Calculate and print cross-correlation
    for (int shift = -maxShift2; shift <= maxShift2; shift++) { //og maxShift
        sxy = 0;
        
        for (int i = 0; i < n; i++) {
            int j = i + shift;
            if (j < 0 || j >= n) continue;
            //if (j < 0 || j >= n){
              //sxy += (x[i] - mx) * (-my);
            //}
            else{
              sxy += (x[i] - mx) * (y[j] - my); 
            }
            
        }
        
        r = sxy / denom;
        //Serial.print("Denom: ");
        //Serial.println(denom);

        if (r > highr){
          highr = r;
          highshift = shift *Ts; //og just shift
        }
        float delaySec = shift * Ts; //og not here
        //shift = shift * .01;
        // serial plotter show shift and cros correlation
        //Serial.print((delaySec));//unshow this on the graph, og shift
        /*
        Serial.print(shift*Ts); //same as line above, trying to save SRAM
        Serial.print(F(","));  
        Serial.println(r,3);  // Correlation coefficient (y-axis)
        */
        
        /* commenting out to see if it works on serial monitor
        Serial.print(delaySec, 5); 
        Serial.print(',');
        Serial.println(r, 5);
        delay(5);
        */
        

        delay(100); 
    }
    Serial.print(F("highest r: "));
    Serial.println(highr,5);
    Serial.println(F("corresponding shift: "));
    Serial.println(highshift,5);
}





void loop() {
  
}
